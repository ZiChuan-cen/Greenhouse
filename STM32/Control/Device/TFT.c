#include "TFT.h"
#include "TFTfont.h"
#include "delay.h"

//const unsigned char  chines_word[   ][32] =  //汉字码
//{
//    //温(0) 度(1) 湿(2) 二(3) 氧(4) 化(5) 碳(6) 浓(7) 光(8) 照(9) 土(10) 壤(11) 大(12) 气(13) 压(14)

//    0x00, 0x00, 0xC4, 0x1F, 0x48, 0x10, 0x48, 0x10, 0xC1, 0x1F, 0x42, 0x10, 0x42, 0x10, 0xC8, 0x1F,
//    0x08, 0x00, 0xE4, 0x3F, 0x27, 0x25, 0x24, 0x25, 0x24, 0x25, 0x24, 0x25, 0xF4, 0x7F, 0x00, 0x00, /*"温",100*/
//    0x80, 0x00, 0x00, 0x01, 0xFC, 0x7F, 0x44, 0x04, 0x44, 0x04, 0xFC, 0x3F, 0x44, 0x04, 0x44, 0x04,
//    0xC4, 0x07, 0x04, 0x00, 0xF4, 0x0F, 0x24, 0x08, 0x42, 0x04, 0x82, 0x03, 0x61, 0x0C, 0x1C, 0x70, /*"度",101*/
//    0x00, 0x00, 0xE4, 0x1F, 0x28, 0x10, 0x28, 0x10, 0xE1, 0x1F, 0x22, 0x10, 0x22, 0x10, 0xE8, 0x1F,
//    0x88, 0x04, 0x84, 0x04, 0x97, 0x24, 0xA4, 0x14, 0xC4, 0x0C, 0x84, 0x04, 0xF4, 0x7F, 0x00, 0x00, /*"湿",102*/
//    0x00, 0x00, 0x00, 0x00, 0x00, 0x00, 0xFC, 0x1F, 0x00, 0x00, 0x00, 0x00, 0x00, 0x00, 0x00, 0x00,
//    0x00, 0x00, 0x00, 0x00, 0x00, 0x00, 0x00, 0x00, 0xFF, 0x7F, 0x00, 0x00, 0x00, 0x00, 0x00, 0x00, /*"二",103*/
//    0x04, 0x00, 0xFC, 0x3F, 0x02, 0x00, 0xF9, 0x0F, 0x00, 0x00, 0xFE, 0x0F, 0x88, 0x08, 0x50, 0x08,
//    0xFE, 0x0B, 0x20, 0x08, 0xFC, 0x09, 0x20, 0x48, 0xFF, 0x57, 0x20, 0x50, 0x20, 0x60, 0x20, 0x40, /*"氧",104*/
//    0x10, 0x01, 0x10, 0x01, 0x10, 0x21, 0x08, 0x11, 0x08, 0x09, 0x0C, 0x05, 0x0C, 0x03, 0x0A, 0x01,
//    0x89, 0x01, 0x48, 0x01, 0x28, 0x01, 0x08, 0x41, 0x08, 0x41, 0x08, 0x41, 0x08, 0x7E, 0x08, 0x00, /*"化",105*/
//    0x00, 0x04, 0x80, 0x24, 0x9F, 0x24, 0x84, 0x24, 0x84, 0x3F, 0x02, 0x01, 0x1E, 0x01, 0xD2, 0x7F,
//    0x13, 0x09, 0x92, 0x08, 0x92, 0x4A, 0x52, 0x2A, 0x5E, 0x15, 0x32, 0x14, 0x10, 0x22, 0x00, 0x41, /*"碳",106*/
//    0x00, 0x02, 0x04, 0x02, 0x08, 0x02, 0xE8, 0x3F, 0x21, 0x21, 0x12, 0x11, 0x82, 0x02, 0x88, 0x22,
//    0xC8, 0x12, 0xA4, 0x0C, 0x97, 0x04, 0x84, 0x08, 0x84, 0x10, 0x84, 0x22, 0x84, 0x41, 0x80, 0x00, /*"浓",107*/
//    0x80, 0x00, 0x84, 0x10, 0x88, 0x10, 0x90, 0x08, 0x90, 0x04, 0x80, 0x00, 0xFF, 0x7F, 0x20, 0x02,
//    0x20, 0x02, 0x20, 0x02, 0x20, 0x02, 0x10, 0x42, 0x10, 0x42, 0x08, 0x42, 0x04, 0x7C, 0x03, 0x00, /*"光",108*/
//    0x00, 0x00, 0xBE, 0x3F, 0x22, 0x22, 0x22, 0x22, 0x22, 0x22, 0x22, 0x29, 0xBE, 0x10, 0x22, 0x3F,
//    0x22, 0x21, 0x22, 0x21, 0x22, 0x21, 0x3E, 0x3F, 0x00, 0x00, 0x12, 0x11, 0x22, 0x22, 0x21, 0x22, /*"照",109*/
//    0x80, 0x00, 0x80, 0x00, 0x80, 0x00, 0x80, 0x00, 0x80, 0x00, 0x80, 0x00, 0xFC, 0x1F, 0x80, 0x00,
//    0x80, 0x00, 0x80, 0x00, 0x80, 0x00, 0x80, 0x00, 0x80, 0x00, 0x80, 0x00, 0xFF, 0x7F, 0x00, 0x00, /*"土",110*/
//    0x04, 0x02, 0xE4, 0x3F, 0x04, 0x00, 0xC4, 0x1D, 0x4F, 0x15, 0xC4, 0x1D, 0x84, 0x08, 0xE4, 0x3F,
//    0x84, 0x08, 0xE4, 0x3F, 0x8C, 0x08, 0xF7, 0x7F, 0x82, 0x14, 0xC0, 0x08, 0xB0, 0x12, 0x80, 0x61, /*"壤",111*/
//    0x80, 0x00, 0x80, 0x00, 0x80, 0x00, 0x80, 0x00, 0x80, 0x00, 0xFF, 0x7F, 0x80, 0x00, 0x80, 0x00,
//    0x40, 0x01, 0x40, 0x01, 0x20, 0x02, 0x20, 0x02, 0x10, 0x04, 0x08, 0x08, 0x04, 0x10, 0x03, 0x60, /*"大",112*/
//    0x08, 0x00, 0x08, 0x00, 0xFC, 0x3F, 0x04, 0x00, 0xF2, 0x0F, 0x01, 0x00, 0xFC, 0x0F, 0x00, 0x08,
//    0x00, 0x08, 0x00, 0x08, 0x00, 0x08, 0x00, 0x08, 0x00, 0x50, 0x00, 0x50, 0x00, 0x60, 0x00, 0x40, /*"气",113*/
//    0x00, 0x00, 0xFC, 0x7F, 0x04, 0x00, 0x04, 0x01, 0x04, 0x01, 0x04, 0x01, 0x04, 0x01, 0xF4, 0x3F,
//    0x04, 0x01, 0x04, 0x01, 0x04, 0x09, 0x04, 0x11, 0x04, 0x11, 0x02, 0x01, 0xFA, 0x7F, 0x01, 0x00, /*"压",114*/


//};


////const unsigned char  picture_tab[PIC_NUM] =
////{
////    /*------------------------------------------------------------------------------
////    120*120   16位彩色图片，取模方式，水平取模，高位在前
////    ------------------------------------------------------------------------------*/
////    
////};



const unsigned char  *point;



void TFT_GPIO_Init(void)
{
	
	RCC->APB2ENR |= 1 << 3; //使能PORTB时钟
    GPIOB->CRL &= 0X000FFFFF;           //将B567口配置为通用推挽输出,最大50MH
    GPIOB->CRL |= 0X33300000;
    GPIOB->CRH &= 0XFFFFFF00;           //将B89口配置为通用推挽输出,最大50MH
    GPIOB->CRH |= 0X00000033;
    GPIOB->ODR = 0XFFFF;
	
//    RCC_APB2PeriphClockCmd(RCC_APB2Periph_GPIOB, ENABLE);
//    GPIO_InitTypeDef GPIO_InitStruct;

//    GPIO_InitStruct.GPIO_Mode = GPIO_Mode_Out_PP;
//    GPIO_InitStruct.GPIO_Speed = GPIO_Speed_50MHz;
//    GPIO_InitStruct.GPIO_Pin = GPIO_Pin_5 | GPIO_Pin_6 | GPIO_Pin_7 | GPIO_Pin_8 | GPIO_Pin_9;
//    GPIO_Init(GPIOB, &GPIO_InitStruct);
//    GPIO_Write(GPIOB, 0xFFFF);
}




void SPI_SendByte(unsigned  char byte)              //向液晶屏写一个8位数据
{

    unsigned char counter;
    SPI_CS_0;

    for (counter = 0; counter < 8; counter++)
    {
        SPI_SCK_0;
        if ((byte & 0x80) == 0)
        {
            SPI_SDA_0;
        }
        else SPI_SDA_1;
        byte = byte << 1;
        SPI_SCK_1;
    }

    SPI_SCK_0;
}

void TFT_SEND_CMD(unsigned char o_command)
{
    SPI_DC_0;
    SPI_CS_0;
    SPI_SendByte(o_command);
    SPI_CS_1;

    //SPI_DC_1;
}
//向液晶屏写一个8位数据
void TFT_SEND_DATA(unsigned  char o_data)
{
    SPI_DC_1;
    SPI_CS_0;
    SPI_SendByte(o_data);
    SPI_CS_1;

}
void TFT_clear(void)
{
    unsigned int ROW, column;
    TFT_SEND_CMD(0x2a);     //Column address set
    TFT_SEND_DATA(0x00);    //start column
    TFT_SEND_DATA(0x00);
    TFT_SEND_DATA(0x00);    //end column
    TFT_SEND_DATA(0xF0);

    TFT_SEND_CMD(0x2b);     //Row address set
    TFT_SEND_DATA(0x00);    //start row
    TFT_SEND_DATA(0x00);
    TFT_SEND_DATA(0x01);    //end row
    TFT_SEND_DATA(0x40);
    TFT_SEND_CMD(0x2C);     //Memory write
    for (ROW = 0; ROW < TFT_LINE_NUMBER; ROW++)      //ROW loop
    {

        for (column = 0; column < TFT_COLUMN_NUMBER; column++) //column loop
        {

            TFT_SEND_DATA(0xFF);
            TFT_SEND_DATA(0xFF);
        }
    }
}
void TFT_full(unsigned int color)
{
    unsigned int ROW, column;
    TFT_SEND_CMD(0x2a);     //Column address set
    TFT_SEND_DATA(0x00);    //start column
    TFT_SEND_DATA(0x00);
    TFT_SEND_DATA(0x00);    //end column
    TFT_SEND_DATA(0xF0);

    TFT_SEND_CMD(0x2b);     //Row address set
    TFT_SEND_DATA(0x00);    //start row
    TFT_SEND_DATA(0x00);
    TFT_SEND_DATA(0x01);    //end row
    TFT_SEND_DATA(0x40);
    TFT_SEND_CMD(0x2C);     //Memory write
    for (ROW = 0; ROW < TFT_LINE_NUMBER; ROW++)      //ROW loop
    {

        for (column = 0; column < TFT_COLUMN_NUMBER ; column++) //column loop
        {

            TFT_SEND_DATA(color >> 8);
            TFT_SEND_DATA(color);
        }
    }
}
void TFT_init(void)
{
    TFT_GPIO_Init();
	SPI_SCK_0;
    SPI_RST_0;
    Delay_ms(1000);
    SPI_RST_1;
    Delay_ms(1000);
    
	
	SPI_RST_0;
    Delay_ms(10);
    SPI_RST_1;
    Delay_ms(120);
//-----------------------ST7789V Frame rate setting-----------------//
//************************************************
    TFT_SEND_CMD(0x3A);        //65k mode
    TFT_SEND_DATA(0x05);
    TFT_SEND_CMD(0xC5);         //VCOM
    TFT_SEND_DATA(0x1A);
    TFT_SEND_CMD(0x36);                 // 屏幕显示方向设置
    TFT_SEND_DATA(0x00);
    //-------------ST7789V Frame rate setting-----------//
    TFT_SEND_CMD(0xb2);     //Porch Setting
    TFT_SEND_DATA(0x05);
    TFT_SEND_DATA(0x05);
    TFT_SEND_DATA(0x00);
    TFT_SEND_DATA(0x33);
    TFT_SEND_DATA(0x33);

    TFT_SEND_CMD(0xb7);         //Gate Control
    TFT_SEND_DATA(0x05);            //12.2v   -10.43v
    //--------------ST7789V Power setting---------------//
    TFT_SEND_CMD(0xBB);//VCOM
    TFT_SEND_DATA(0x3F);

    TFT_SEND_CMD(0xC0); //Power control
    TFT_SEND_DATA(0x2c);

    TFT_SEND_CMD(0xC2);     //VDV and VRH Command Enable
    TFT_SEND_DATA(0x01);

    TFT_SEND_CMD(0xC3);         //VRH Set
    TFT_SEND_DATA(0x0F);        //4.3+( vcom+vcom offset+vdv)

    TFT_SEND_CMD(0xC4);         //VDV Set
    TFT_SEND_DATA(0x20);                //0v

    TFT_SEND_CMD(0xC6);             //Frame Rate Control in Normal Mode
    TFT_SEND_DATA(0X01);            //111Hz

    TFT_SEND_CMD(0xd0);             //Power Control 1
    TFT_SEND_DATA(0xa4);
    TFT_SEND_DATA(0xa1);

    TFT_SEND_CMD(0xE8);             //Power Control 1
    TFT_SEND_DATA(0x03);

    TFT_SEND_CMD(0xE9);             //Equalize time control
    TFT_SEND_DATA(0x09);
    TFT_SEND_DATA(0x09);
    TFT_SEND_DATA(0x08);
    //---------------ST7789V gamma setting-------------//
    TFT_SEND_CMD(0xE0); //Set Gamma
    TFT_SEND_DATA(0xD0);
    TFT_SEND_DATA(0x05);
    TFT_SEND_DATA(0x09);
    TFT_SEND_DATA(0x09);
    TFT_SEND_DATA(0x08);
    TFT_SEND_DATA(0x14);
    TFT_SEND_DATA(0x28);
    TFT_SEND_DATA(0x33);
    TFT_SEND_DATA(0x3F);
    TFT_SEND_DATA(0x07);
    TFT_SEND_DATA(0x13);
    TFT_SEND_DATA(0x14);
    TFT_SEND_DATA(0x28);
    TFT_SEND_DATA(0x30);

    TFT_SEND_CMD(0XE1); //Set Gamma
    TFT_SEND_DATA(0xD0);
    TFT_SEND_DATA(0x05);
    TFT_SEND_DATA(0x09);
    TFT_SEND_DATA(0x09);
    TFT_SEND_DATA(0x08);
    TFT_SEND_DATA(0x03);
    TFT_SEND_DATA(0x24);
    TFT_SEND_DATA(0x32);
    TFT_SEND_DATA(0x32);
    TFT_SEND_DATA(0x3B);
    TFT_SEND_DATA(0x14);
    TFT_SEND_DATA(0x13);
    TFT_SEND_DATA(0x28);
    TFT_SEND_DATA(0x2F);

    TFT_SEND_CMD(0x20);         //反显
    TFT_SEND_CMD(0x11); //Exit Sleep // 退出睡眠模式
    Delay_ms(120);
    TFT_SEND_CMD(0x29); //Display on // 开显示
}



/*




*/
void display_char16_16(unsigned int x, unsigned int y, unsigned long color, unsigned char word_serial_number)
{
//    x = x + 15;
//    y = y + 15;

    unsigned int column;
    unsigned char tm = 0, temp = 0, xxx = 0;

    TFT_SEND_CMD(0x2a);    //Column address set
    TFT_SEND_DATA(x >> 8);  //start column
    TFT_SEND_DATA(x);
    x = x + 15;
    TFT_SEND_DATA(x >> 8);  //end column
    TFT_SEND_DATA(x);

    TFT_SEND_CMD(0x2b);     //Row address set
    TFT_SEND_DATA(y >> 8);  //start row
    TFT_SEND_DATA(y);
    y = y + 15;
    TFT_SEND_DATA(y >> 8);  //end row
    TFT_SEND_DATA(y);
    TFT_SEND_CMD(0x2C);     //Memory write


    for (column = 0; column < 32; column++) //column loop
    {
        temp = chines_word[  word_serial_number ][xxx];
        for (tm = 0; tm < 8; tm++)
        {
            if (temp & 0x01)
            {
                TFT_SEND_DATA(color >> 8);
                TFT_SEND_DATA(color);
            }
            else
            {
                TFT_SEND_DATA(0XFF);
                TFT_SEND_DATA(0XFF);
            }
            temp >>= 1;
        }
        xxx++;

    }
}

void Picture_Display(const unsigned char *ptr_pic)
{
    unsigned long  number;
    TFT_SEND_CMD(0x2a);         //Column address set
    TFT_SEND_DATA(0x00);        //start column
    TFT_SEND_DATA(0x00);
    TFT_SEND_DATA(0x00);        //end column
    TFT_SEND_DATA(0x77);

    TFT_SEND_CMD(0x2b);         //Row address set
    TFT_SEND_DATA(0x00);        //start row
    TFT_SEND_DATA(0x00);
    TFT_SEND_DATA(0x00);        //end row
    TFT_SEND_DATA(0x78);
    TFT_SEND_CMD(0x2C);         //Memory write

    for (number = 0; number < PIC_NUM; number++)
    {
//            data=*ptr_pic++;
//            data=~data;
        TFT_SEND_DATA(*ptr_pic++);


    }
}


